## samples/drivers/exmif_test/Kconfig
```kconfig
# Copyright (c) 2024 Nordic Semiconductor ASA
# SPDX-License-Identifier: Apache-2.0

mainmenu "SPI Flash Sample"

config SPI_FLASH_SINGLE_SECTOR_TEST
	bool "Single sector test"

config SPI_FLASH_ERASE_TEST_REGION
	bool "erase all test region info"

config SPI_FLASH_EXMIF_TEST_REGION_OFFSET
	hex "EXMIF test region start offset (bytes)"
	#default 0xff000
	default 0x0
	help
	  Start address of the flash region to test. Only non-erased bytes
	  in this region will be printed. Set test size to 0 to disable.

config SPI_FLASH_EXMIF_TEST_REGION_SIZE
	hex "EXMIF test region size (bytes)"
	default 0x90000
	help
	  Number of bytes to test from the region offset. If 0, the test
	  is disabled. Erased value is 0xFF; only lines containing
	  non-erased bytes are printed.

source "Kconfig.zephyr"
```

## soc/nordic/common/uicr/Kconfig.template.gen_uicr_snapshot_region
```kconfig
# Copyright (c) 2026 Nordic Semiconductor ASA
# SPDX-License-Identifier: LicenseRef-Nordic-5-Clause

config GEN_UICR_SNAPSHOT_REGION_$(index)
	bool "UICR.SNAPSHOT region"
	depends on GEN_UICR_SNAPSHOT_REGIONS
	help
	  When enabled, configures a UICR.SNAPSHOT region.

config GEN_UICR_SNAPSHOT_REGION_$(index)_ADDRESS
	hex "UICR.SNAPSHOT region start address"
	range 0x0e030000 0x0e1ff000
	depends on GEN_UICR_SNAPSHOT_REGION_$(index)
	help
	  UICR.SNAPSHOT region start address. Must be aligned to a 4KB boundary.

config GEN_UICR_SNAPSHOT_REGION_$(index)_SIZE_KB
	int "UICR.SNAPSHOT region size in KB"
	range 1 4095
	depends on GEN_UICR_SNAPSHOT_REGION_$(index)
	help
	  UICR.SNAPSHOT region size in number of 1KB blocks.
```
